#include "dht11.h"

/********************************************************************************************************
** 函数: DHT11_Init,  DHT11初始化
**------------------------------------------------------------------------------------------------------
** 参数: 无
** 返回: 0：初始化成功，1：失败										  
********************************************************************************************************/
uint8 DHT11_Init()
{
	GPIO_InitTypeDef GPIO_InitStructure;

	RCC_APB2PeriphClockCmd(RCC_APB2Periph_GPIOG,ENABLE);

	GPIO_InitStructure.GPIO_Pin=DHT11;			//PG11
	GPIO_InitStructure.GPIO_Mode=GPIO_Mode_Out_PP;
	GPIO_InitStructure.GPIO_Speed=GPIO_Speed_50MHz;
	GPIO_Init(GPIO_DHT11,&GPIO_InitStructure);
	GPIO_SetBits(GPIO_DHT11,DHT11);	   //拉高

	DHT11_Rst();	  
	PrintfToHMI("DHT11 Init..." ,"page_Init", "InitDHT11Txt", "txt");
	return DHT11_Check();	
}

/********************************************************************************************************
** 函数: DHT11_Rst,  复位DHT11
**------------------------------------------------------------------------------------------------------
** 参数: 无
** 返回: 0：初始化成功，1：失败										  
********************************************************************************************************/
void DHT11_Rst()	   
{                 
	DHT11_IO_OUT(); 	//SET OUTPUT
    DHT11_DQ_OUT=0; 	//拉低DQ
    delay_ms(20);    	//拉低至少18ms
    DHT11_DQ_OUT=1; 	//DQ=1 
	delay_us(30);     	//主机拉高20~40us
}

/********************************************************************************************************
** 函数: DHT11_Check,  等待DHT11的回应
**------------------------------------------------------------------------------------------------------
** 参数: 无
** 返回: 0：存在，1：未检测到DHT11的存在						  
********************************************************************************************************/
uint8 DHT11_Check() 	   
{   
	uint8 retry=0;
	DHT11_IO_IN();//SET INPUT	 
    while (DHT11_DQ_IN&&retry<100)//DHT11会拉低40~50us
	{
		retry++;
		delay_us(1);
	};	 
	if(retry>=100)return 1;
	else retry=0;
    while (!DHT11_DQ_IN&&retry<100)//DHT11拉低后会再次拉高40~50us
	{
		retry++;
		delay_us(1);
	};
	if(retry>=100)return 1;	    
	return 0;
}

/********************************************************************************************************
** 函数: DHT11_Read_Bit,  从DHT11读取一个位
**------------------------------------------------------------------------------------------------------
** 参数: 无
** 返回: 0：成功，1：失败					  
********************************************************************************************************/
uint8 DHT11_Read_Bit(void) 			 
{
 	uint8 retry=0;
	while(DHT11_DQ_IN&&retry<100)//等待变为低电平 12-14us 开始
	{
		retry++;
		delay_us(1);
	}
	retry=0;
	while(!DHT11_DQ_IN&&retry<100)//等待变高电平	 26-28us表示0,116-118us表示1
	{
		retry++;
		delay_us(1);
	}
	delay_us(40);//等待40us
	if(DHT11_DQ_IN)return 1;
	else return 0;		   
}

/********************************************************************************************************
** 函数: DHT11_Read_Bit,  从DHT11读取一个字节
**------------------------------------------------------------------------------------------------------
** 参数: 无
** 返回: 读到的数据			  
********************************************************************************************************/
uint8 DHT11_Read_Byte(void)    
{        
    uint8 i,dat;
    dat=0;
	for (i=0;i<8;i++) 
	{
   		dat<<=1; 
	    dat|=DHT11_Read_Bit();
    }						    
    return dat;
}

/********************************************************************************************************
** 函数: DHT11_Read_Data, 从DHT11读取一次数据
**------------------------------------------------------------------------------------------------------
** 参数: temp:温度值(范围:0~50°) humi:湿度值(范围:20%~90%)
** 返回: 0,正常;1,读取失败
********************************************************************************************************/
uint8 DHT11_Read_Data(uint8 *temp,uint8 *humi)    
{        
 	uint8 buf[5];
	uint8 i;
	DHT11_Rst();
	if(DHT11_Check()==0)
	{
		for(i=0;i<5;i++)//读取40位数据
		{
			buf[i]=DHT11_Read_Byte();
		}
		if((buf[0]+buf[1]+buf[2]+buf[3])==buf[4])
		{
			*humi=buf[0];
			*temp=buf[2];
		}
		
	}else return 1;
	return 0;	    
}

/********************************************************************************************************
** 函数: DHT11_IO_OUT, DHT11输出模式配置
**------------------------------------------------------------------------------------------------------
** 参数: 无
** 返回: 无
********************************************************************************************************/
void DHT11_IO_OUT(void)	
{
	GPIO_InitTypeDef GPIO_InitStructure;
	GPIO_InitStructure.GPIO_Pin=DHT11;
	GPIO_InitStructure.GPIO_Mode=GPIO_Mode_Out_PP;	 //推挽输出
	GPIO_InitStructure.GPIO_Speed=GPIO_Speed_50MHz;
	GPIO_Init(GPIO_DHT11,&GPIO_InitStructure);	
}

/********************************************************************************************************
** 函数: DHT11_IO_IN, DHT11输入模式配置
**------------------------------------------------------------------------------------------------------
** 参数: 无
** 返回: 无
********************************************************************************************************/
void DHT11_IO_IN(void)	
{
	GPIO_InitTypeDef GPIO_InitStructure;
	GPIO_InitStructure.GPIO_Pin=DHT11;
	GPIO_InitStructure.GPIO_Mode=GPIO_Mode_IPU;	 //上拉输入模式
	GPIO_Init(GPIO_DHT11,&GPIO_InitStructure);	
}

/*********************************************************************************************************
**                            End Of File
********************************************************************************************************/
